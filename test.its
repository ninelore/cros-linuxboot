## test.its
```
/dts-v1/;

/ {
    description = "Linux payload";
    #address-cells = <1>;

    images {
        kernel {
            description = "Linux kernel";
            data = /incbin/("arch/arm64/boot/Image.lzma");
            type = "kernel";
            arch = "arm64";
            os = "linux";
            compression = "lzma";
            load = <0x80000>;
            entry = <0x80000>;
            hash-1 {
                algo = "crc32";
            };
        };
        fdt-1 {
            description = "Flattened Device Tree blob";
            data = /incbin/("arch/arm64/boot/dts/mediatek/mt8195-cherry-tomato-r3.dtb");
            type = "flat_dt";
            arch = "arm64";
            compression = "none";
            hash-1 {
                algo = "crc32";
            };
        };
    };

    configurations {
        default = "conf-1";
        conf-1 {
            description = "Boot Linux kernel with FDT blob";
            kernel = "kernel";
            fdt = "fdt-1";
        };
    };
};
```
